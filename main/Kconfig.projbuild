## main/Kconfig.projbuild
```kconfig
menu "JustRide board"
config JUSTRIDE_ROUND_AMOLED
    bool "Waveshare ESP32-S3-Touch-AMOLED-1.43"
    default y
    depends on IDF_TARGET_ESP32S3
if JUSTRIDE_ROUND_AMOLED
config JR_POWER_GAIN_PERMILLE
    int "Supply-voltage divider correction (1000 = nominal 200k/100k)"
    range 900 1100
    default 1000
config JR_GYRO_INVERT_TURN
    bool "Invert gyroscope turn direction for mounting"
choice JR_PANEL_MODEL
    prompt "AMOLED panel variant"
    default JR_PANEL_AUTO
config JR_PANEL_AUTO
    bool "Detect ID (Waveshare V3 procedure)"
config JR_PANEL_SH8601
    bool "Force SH8601 (X offset 0)"
config JR_PANEL_CO5300
    bool "Force CO5300 (X offset 6)"
endchoice
config JR_TOUCH_SWAP_XY
    bool "Swap touch X/Y"
config JR_TOUCH_MIRROR_X
    bool "Mirror touch X"
config JR_TOUCH_MIRROR_Y
    bool "Mirror touch Y"
endif
endmenu
```

## sdkconfig.defaults
```kconfig
CONFIG_IDF_TARGET="esp32s3"
CONFIG_JUSTRIDE_ROUND_AMOLED=y
CONFIG_ESPTOOLPY_FLASHSIZE_16MB=y
CONFIG_ESPTOOLPY_FLASHSIZE="16MB"
CONFIG_SPIRAM=y
CONFIG_SPIRAM_MODE_OCT=y
CONFIG_SPIRAM_SPEED_80M=y
CONFIG_SPIRAM_USE_MALLOC=y
CONFIG_SPIRAM_MALLOC_ALWAYSINTERNAL=4096
CONFIG_ESP_CONSOLE_USB_SERIAL_JTAG=y
CONFIG_LOG_DEFAULT_LEVEL=3
CONFIG_PARTITION_TABLE_CUSTOM=y
CONFIG_PARTITION_TABLE_CUSTOM_FILENAME="partitions.csv"
CONFIG_BOOTLOADER_APP_ROLLBACK_ENABLE=y
CONFIG_BT_ENABLED=y
CONFIG_BT_BLE_ENABLED=y
CONFIG_BT_NIMBLE_ENABLED=y
CONFIG_BT_NIMBLE_NVS_PERSIST=y
CONFIG_BT_NIMBLE_SM_LVL=3
CONFIG_BT_NIMBLE_SM_SC_ONLY=1
```

## sdkconfig.defaults.esp32
```kconfig
CONFIG_IDF_TARGET="esp32"
# CONFIG_JUSTRIDE_ROUND_AMOLED is not set
CONFIG_ESPTOOLPY_FLASHSIZE_4MB=y
CONFIG_ESPTOOLPY_FLASHSIZE="4MB"
CONFIG_LOG_DEFAULT_LEVEL=3
CONFIG_PARTITION_TABLE_CUSTOM=y
CONFIG_PARTITION_TABLE_CUSTOM_FILENAME="partitions.csv"
CONFIG_BOOTLOADER_APP_ROLLBACK_ENABLE=y
CONFIG_BT_ENABLED=y
CONFIG_BT_BLE_ENABLED=y
CONFIG_BT_NIMBLE_ENABLED=y
```
